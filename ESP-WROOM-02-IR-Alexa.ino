#include <Arduino.h>
#include <ESP8266WiFi.h>
#include "fauxmoESP.h"
#include <ESP8266mDNS.h>
#include <IRremoteESP8266.h>
#include <IRsend.h>

#define WIFI_SSID "change-ssid"
#define WIFI_PASS "change-pass"
#define SERIAL_BAUDRATE 115200
#define RELAY_PIN 12
#define IRLEDPIN 14

IRsend irsend(14);


//DAIKIN POWER ON/OFF C3（irsend.sendRawを使う場合はunsigned intをuint16_tにしてください)
unsigned int rawDataAR1OFF[583] = {488, 386,  514, 360,  510, 364,  510, 364,  510, 364,  510, 25414,  3544,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 1238,  510};  // DAIKIN
//unsigned int rawDataAR1OFF[583] = {510, 360,  492, 380,  492, 382,  514, 360,  488, 386,  514, 25408,  3522,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 1208,  540};  // DAIKIN

//DAIKIN POWER ON/OFF C4（irsend.sendRawを使う場合はunsigned intをuint16_tにしてください)
unsigned int rawDataAR1ON[583] = {510, 364,  510, 358,  514, 360,  514, 360,  514, 360,  514, 25410,  3574,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 1208,  540};  // DAIKIN
//unsigned int rawDataAR1ON[583] = {510, 364,  510, 360,  514, 360,  514, 358,  514, 360,  514, 25412,  3522,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 1234,  514};  // DAIKIN


//IRIS LIGHT MEMORY POWER ON（irsend.sendRawを使う場合はunsigned intをuint16_tにしてください)
unsigned int rawDataLT1ON[257] = {2076, 946,  5570, 1000,  1536, 438,  566, 438,  566, 434,  566, 438,  570,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 476,  550};  // UNKNOWN AA79DC16

//IRIS LIGHT POWER OFF（irsend.sendRawを使う場合はunsigned intをuint16_tにしてください)
unsigned int rawDataLT1OFF[257] = {2102, 926,  5590, 982,  1536, 432,  546, 458,  568, 432,  572, 432,  566,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 446,  550};  // UNKNOWN EC890164

//SONY TV　POWER ON/OFF（irsend.sendRawを使う場合はunsigned intをuint16_tにしてください)
unsigned int rawDataTV1[103] = {2464, 516,  1272, 520,  670, 520,  1266, 520,  650, 542,  1272, 542,  676,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 520,  648};  // SONY A90


fauxmoESP fauxmo;
//制御するスイッチの数にあわせて調整
bool roomswitch[4]= {false, false, false, false};

void wifiSetup() {

    // Set WIFI module to STA mode
    WiFi.mode(WIFI_STA);

    // Connect
    Serial.printf("[WIFI] Connecting to %s ", WIFI_SSID);
    WiFi.begin(WIFI_SSID, WIFI_PASS);

    // Wait
    while (WiFi.status() != WL_CONNECTED) {
        Serial.print(".");
        delay(100);
    }

    Serial.println();

    // Connected!
    Serial.printf("[WIFI] STATION Mode, SSID: %s, IP address: %s\n", WiFi.SSID().c_str(), WiFi.localIP().toString().c_str());
}

void callbackSetState(unsigned char device_id, const char * device_name, bool state){
   Serial.printf("[MAIN] Device #%d (%s) state: %s\n", device_id, device_name, state ? "ON" : "OFF");
   roomswitch[device_id] = state;

  //もう少しかっこいいフローにしたかったんですが・・・コールバックでオンかオフが見えているようだったので、
  //デバイスIDとオンコールかオフコールかの条件をみて実行するようにしています。
  if ((device_id == 0)&&(roomswitch[device_id] == true)) {
        //irsend.sendRaw(rawDataAR1ON, 583, 38);
        sendIRData(rawDataAR1ON, 583);
        Serial.println("Call:Living Aircon ON");
        delay(1000);
  }
  if ((device_id == 0)&&(roomswitch[device_id] == false)) {
        //irsend.sendRaw(rawDataAR1OFF, 583, 38);
        sendIRData(rawDataAR1OFF, 583);
        Serial.println("Call:Living Aircon OFF");
        delay(1000);
  }
  if ((device_id == 1)&&(roomswitch[device_id] == true)) {
        //irsend.sendRaw(rawDataLT1ON, 257, 38);
        sendIRData(rawDataLT1ON, 257);
        Serial.println("Call:Living Light ON");
        delay(1000);
  }
  if ((device_id == 1)&&(roomswitch[device_id] == false)) {
        //irsend.sendRaw(rawDataLT1OFF, 257, 38);
        sendIRData(rawDataLT1OFF, 257);
        Serial.println("Call:Living Light OFF");
        delay(1000);
  }
   if ( device_id == 2) {
        //irsend.sendRaw(rawDataTV1, 103, 38);
        sendIRData(rawDataTV1, 103);
        Serial.println("Call:Living TV");
        delay(1000);
  }
}

bool callbackGetState(unsigned char device_id, const char * device_name){
  return roomswitch[device_id];
}

void setup() {

  // Serial
  Serial.begin(SERIAL_BAUDRATE);
  Serial.println();
  Serial.println();

  // Wifi
  wifiSetup();
  irsend.begin();
  delay(10);

  fauxmo.enable(true);

  //ここでデバイスネームを決めます。Alexaアプリ側で日本語に書き換えればOKっす
  fauxmo.addDevice("Living Aircon");
  fauxmo.addDevice("Living Light");
  fauxmo.addDevice("Living TV");

  // Calback
  fauxmo.onSetState(callbackSetState);
  fauxmo.onGetState(callbackGetState);
}


void loop() {
  fauxmo.handle();
}

//SWITCHSCIENCE様の赤外線送信フローをそのまま流用
void sendIRData(unsigned int  *data, int dataSize)
{
  unsigned int i=0,power=HIGH;

  digitalWrite(IRLEDPIN, LOW);

  while(i < dataSize)
  {
    if(power == HIGH)
    {
      long startedTime = micros();
      while(micros() - startedTime < data[i])
      {
        digitalWrite(IRLEDPIN, HIGH);
        delayMicroseconds(8);
        digitalWrite(IRLEDPIN, LOW);
        delayMicroseconds(13);
      }

      power = LOW;
    }else{
      digitalWrite(IRLEDPIN, LOW);
      delayMicroseconds(data[i]);
      power = HIGH;
    }
    i++;
  }

  digitalWrite(IRLEDPIN, LOW);

}
